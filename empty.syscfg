/**
 * These arguments were used when this file was generated. They will be automatically applied on subsequent loads
 * via the GUI or CLI. Run CLI with '--help' for additional information on how to override these arguments.
 * @cliArgs --device "MSPM0G350X" --part "Default" --package "LQFP-64(PM)" --product "mspm0_sdk@2.10.00.04"
 * @v2CliArgs --device "MSPM0G3507" --package "LQFP-64(PM)" --product "mspm0_sdk@2.10.00.04"
 * @versions {"tool":"1.27.1+4634"}
 */

/**
 * Import the modules used in this configuration.
 */
const ADC12         = scripting.addModule("/ti/driverlib/ADC12", {}, false);
const ADC121        = ADC12.addInstance();
const CRC           = scripting.addModule("/ti/driverlib/CRC");
const DMA           = scripting.addModule("/ti/driverlib/DMA");
const GPIO          = scripting.addModule("/ti/driverlib/GPIO", {}, false);
const GPIO1         = GPIO.addInstance();
const I2C           = scripting.addModule("/ti/driverlib/I2C", {}, false);
const I2C1          = I2C.addInstance();
const PWM           = scripting.addModule("/ti/driverlib/PWM", {}, false);
const PWM1          = PWM.addInstance();
const PWM2          = PWM.addInstance();
const PWM3          = PWM.addInstance();
const PWM4          = PWM.addInstance();
const SPI           = scripting.addModule("/ti/driverlib/SPI", {}, false);
const SPI1          = SPI.addInstance();
const SYSCTL        = scripting.addModule("/ti/driverlib/SYSCTL");
const SYSTICK       = scripting.addModule("/ti/driverlib/SYSTICK");
const TIMER         = scripting.addModule("/ti/driverlib/TIMER", {}, false);
const TIMER1        = TIMER.addInstance();
const UART          = scripting.addModule("/ti/driverlib/UART", {}, false);
const UART1         = UART.addInstance();
const ProjectConfig = scripting.addModule("/ti/project_config/ProjectConfig");

/**
 * Write custom configuration values to the imported modules.
 */
ADC121.$name               = "ADC12_0";
ADC121.adcPin0Config.$name = "ti_driverlib_gpio_GPIOPinGeneric0";

const Board = scripting.addModule("/ti/driverlib/Board", {}, false);


GPIO1.$name                   = "GPIO_GRP_0";
GPIO1.associatedPins[0].$name = "PIN_0";

I2C1.$name              = "I2C_0";
I2C1.sdaPinConfig.$name = "ti_driverlib_gpio_GPIOPinGeneric1";
I2C1.sclPinConfig.$name = "ti_driverlib_gpio_GPIOPinGeneric2";

PWM1.$name               = "PWM_0";
PWM1.PWM_CHANNEL_0.$name = "ti_driverlib_pwm_PWMTimerCC0";
PWM1.PWM_CHANNEL_1.$name = "ti_driverlib_pwm_PWMTimerCC1";
PWM1.ccp0PinConfig.$name = "ti_driverlib_gpio_GPIOPinGeneric9";
PWM1.ccp1PinConfig.$name = "ti_driverlib_gpio_GPIOPinGeneric10";

PWM2.$name               = "PWM_1";
PWM2.PWM_CHANNEL_0.$name = "ti_driverlib_pwm_PWMTimerCC2";
PWM2.PWM_CHANNEL_1.$name = "ti_driverlib_pwm_PWMTimerCC3";
PWM2.ccp0PinConfig.$name = "ti_driverlib_gpio_GPIOPinGeneric11";
PWM2.ccp1PinConfig.$name = "ti_driverlib_gpio_GPIOPinGeneric12";

PWM3.$name               = "PWM_2";
PWM3.PWM_CHANNEL_0.$name = "ti_driverlib_pwm_PWMTimerCC4";
PWM3.PWM_CHANNEL_1.$name = "ti_driverlib_pwm_PWMTimerCC5";
PWM3.ccp0PinConfig.$name = "ti_driverlib_gpio_GPIOPinGeneric13";
PWM3.ccp1PinConfig.$name = "ti_driverlib_gpio_GPIOPinGeneric14";

PWM4.$name               = "PWM_3";
PWM4.PWM_CHANNEL_0.$name = "ti_driverlib_pwm_PWMTimerCC6";
PWM4.PWM_CHANNEL_1.$name = "ti_driverlib_pwm_PWMTimerCC7";
PWM4.ccp0PinConfig.$name = "ti_driverlib_gpio_GPIOPinGeneric15";
PWM4.ccp1PinConfig.$name = "ti_driverlib_gpio_GPIOPinGeneric16";

SPI1.$name               = "SPI_0";
SPI1.sclkPinConfig.$name = "ti_driverlib_gpio_GPIOPinGeneric3";
SPI1.mosiPinConfig.$name = "ti_driverlib_gpio_GPIOPinGeneric4";
SPI1.misoPinConfig.$name = "ti_driverlib_gpio_GPIOPinGeneric5";
SPI1.cs0PinConfig.$name  = "ti_driverlib_gpio_GPIOPinGeneric6";

SYSCTL.forceDefaultClkConfig = true;

TIMER1.$name = "TIMER_0";

UART1.$name             = "UART_0";
UART1.txPinConfig.$name = "ti_driverlib_gpio_GPIOPinGeneric7";
UART1.rxPinConfig.$name = "ti_driverlib_gpio_GPIOPinGeneric8";

ProjectConfig.genLibCMSIS = true;

/**
 * Pinmux solution for unlocked pins/peripherals. This ensures that minor changes to the automatic solver in a future
 * version of the tool will not impact the pinmux you originally saw.  These lines can be completely deleted in order to
 * re-solve from scratch.
 */
ADC121.peripheral.$suggestSolution           = "ADC0";
ADC121.peripheral.adcPin0.$suggestSolution   = "PA27";
Board.peripheral.$suggestSolution            = "DEBUGSS";
Board.peripheral.swclkPin.$suggestSolution   = "PA20";
Board.peripheral.swdioPin.$suggestSolution   = "PA19";
CRC.peripheral.$suggestSolution              = "CRC";
GPIO1.associatedPins[0].pin.$suggestSolution = "PB13";
I2C1.peripheral.$suggestSolution             = "I2C0";
I2C1.peripheral.sdaPin.$suggestSolution      = "PA0";
I2C1.peripheral.sclPin.$suggestSolution      = "PA1";
PWM1.peripheral.$suggestSolution             = "TIMG7";
PWM1.peripheral.ccp0Pin.$suggestSolution     = "PA17";
PWM1.peripheral.ccp1Pin.$suggestSolution     = "PA18";
PWM2.peripheral.$suggestSolution             = "TIMG6";
PWM2.peripheral.ccp0Pin.$suggestSolution     = "PA21";
PWM2.peripheral.ccp1Pin.$suggestSolution     = "PA22";
PWM3.peripheral.$suggestSolution             = "TIMG0";
PWM3.peripheral.ccp0Pin.$suggestSolution     = "PA12";
PWM3.peripheral.ccp1Pin.$suggestSolution     = "PA13";
PWM4.peripheral.$suggestSolution             = "TIMA1";
PWM4.peripheral.ccp0Pin.$suggestSolution     = "PA10";
PWM4.peripheral.ccp1Pin.$suggestSolution     = "PA11";
SPI1.peripheral.$suggestSolution             = "SPI0";
SPI1.peripheral.sclkPin.$suggestSolution     = "PA6";
SPI1.peripheral.mosiPin.$suggestSolution     = "PA14";
SPI1.peripheral.misoPin.$suggestSolution     = "PA4";
SPI1.peripheral.cs0Pin.$suggestSolution      = "PA2";
SYSCTL.peripheral.$suggestSolution           = "SYSCTL";
TIMER1.peripheral.$suggestSolution           = "TIMA0";
UART1.peripheral.$suggestSolution            = "UART0";
UART1.peripheral.rxPin.$suggestSolution      = "PA31";
UART1.peripheral.txPin.$suggestSolution      = "PA28";
